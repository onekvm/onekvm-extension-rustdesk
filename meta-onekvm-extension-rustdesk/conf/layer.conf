## meta-onekvm-extension-rustdesk/conf/layer.conf
```bitbake
BBPATH .= ":${LAYERDIR}"
BBFILES += "${LAYERDIR}/recipes-*/*/*.bb ${LAYERDIR}/recipes-*/*/*.bbappend"
BBFILE_COLLECTIONS += "onekvm-extension-rustdesk"
BBFILE_PATTERN_onekvm-extension-rustdesk := "^${LAYERDIR}/"
BBFILE_PRIORITY_onekvm-extension-rustdesk = "8"
LAYERDEPENDS_onekvm-extension-rustdesk = "core onekvm"
LAYERSERIES_COMPAT_onekvm-extension-rustdesk = "wrynose"
```
